## CMakeLists.txt
```
#
# Copyright (c) 2018 Nordic Semiconductor
#
# SPDX-License-Identifier: LicenseRef-Nordic-5-Clause
#

cmake_minimum_required(VERSION 3.20.0)

find_package(Zephyr REQUIRED HINTS $ENV{ZEPHYR_BASE})
project(NONE)

FILE(GLOB app_sources src/*.cpp)
# NORDIC SDK APP START
target_sources(app PRIVATE
	${app_sources}
)
# NORDIC SDK APP END

zephyr_library_include_directories(${ZEPHYR_BASE}/samples/bluetooth)
```

## prj.conf
```kconfig
#USB config
#---------------------------
CONFIG_USB_DEVICE_STACK=y
CONFIG_USB_CDC_ACM=y
CONFIG_USB_CDC_ACM_RINGBUF_SIZE= 32768
CONFIG_USB_DEVICE_PRODUCT="BLE-ITS RX"
CONFIG_USB_DRIVER_LOG_LEVEL_INF=y
CONFIG_USB_DEVICE_LOG_LEVEL_INF=y
#---------------------------

# UART CONFIG 
CONFIG_UART_LINE_CTRL=y
CONFIG_UART_WIDE_DATA=y
#-----LPUART----------------------
#CONFIG_NRF_SW_LPUART_MAX_PACKET_SIZE=1024
#CONFIG_NRF_SW_LPUART=y
#-----INTERRUPT-DRIVEN UART API-----
CONFIG_UART_INTERRUPT_DRIVEN=y
CONFIG_UART_0_INTERRUPT_DRIVEN=y
#CONFIG_UART_1_INTERRUPT_DRIVEN=y
#------ASYNC UART API-------------
CONFIG_UART_ASYNC_API=n
CONFIG_UART_0_ASYNC=n
CONFIG_UART_0_NRF_HW_ASYNC=n
#CONFIG_UART_0_NRF_HW_ASYNC_TIMER=1
CONFIG_NRFX_TIMER0=n
#---------------------------


#Size of the heap memory pool when using k_malloc()
CONFIG_HEAP_MEM_POOL_SIZE=65536

#Bluetooth
#----------------------
CONFIG_BT=y
CONFIG_BT_DEBUG_LOG=y
CONFIG_BT_DEVICE_NAME="CTS Client"
CONFIG_BT_LL_SOFTDEVICE_MULTIROLE=y

CONFIG_BT_OBSERVER=y
CONFIG_BT_PERIPHERAL=y
CONFIG_BT_CENTRAL=y
CONFIG_BT_CTLR=y

CONFIG_BT_SMP=y
CONFIG_BT_GATT_CLIENT=y
CONFIG_BT_GATT_DM=y
CONFIG_BT_CTS_CLIENT=y

CONFIG_BT_EXT_ADV=y
CONFIG_BT_CTLR_RX_BUFFERS=18
CONFIG_BT_LL_SW_SPLIT=n #Zephyr controller
CONFIG_BT_LL_SOFTDEVICE=y#Softdevice
CONFIG_BT_RX_STACK_SIZE=3072
CONFIG_BT_EXT_SCAN_BUF_SIZE=1650
#CONFIG_BT_BUF_COMD_TX_COUNT workarround para el problema del semáforo en hci
CONFIG_BT_BUF_CMD_TX_COUNT=10
CONFIG_BT_CTLR_EXT_SCAN_FP=y 
CONFIG_BT_SCAN=y
CONFIG_BT_SCAN_FILTER_ENABLE=y
CONFIG_BT_SCAN_UUID_CNT=10
CONFIG_BT_SCAN_SHORT_NAME_MAX_LEN=64
CONFIG_BT_SCAN_SHORT_NAME_CNT=10
CONFIG_BT_LOG_LEVEL_INF=y
#---------------------------

# Enable bonding
#---------------------------
CONFIG_BT_SETTINGS=n
CONFIG_FLASH=y
CONFIG_FLASH_PAGE_LAYOUT=y
CONFIG_FLASH_MAP=y
CONFIG_NVS=y
CONFIG_SETTINGS=y
#---------------------------

# Enable DK LED and Buttons library
CONFIG_DK_LIBRARY=y

# Config logger
#---------------------------
CONFIG_LOG=y
CONFIG_LOG_PRINTK=y #redirige las llamadas a printk al logging
CONFIG_LOG_MODE_IMMEDIATE=y #No se puede usar con el controlador zephyr
CONFIG_LOG_MODE_DEFERRED=n
CONFIG_LOG_BACKEND_RTT_OUTPUT_BUFFER_SIZE=32768
CONFIG_LOG_BACKEND_UART=n
CONFIG_ASSERT=y
CONFIG_RTT_CONSOLE=y
CONFIG_LOG_BACKEND_FORMAT_TIMESTAMP=y
CONFIG_LOG_BACKEND_SHOW_COLOR=y
CONFIG_LOG_INFO_COLOR_GREEN=y
CONFIG_NO_OPTIMIZATIONS=y
CONFIG_THREAD_NAME=y
CONFIG_LOG_BACKEND_RTT=y
CONFIG_SEGGER_RTT_MODE_BLOCK_IF_FIFO_FULL=y
#CONFIG_LOG_BUFFER_SIZE=32768 (no se puede configurar si CONFIG_LOG_MODE_IMMEDIATE=y)
#---------------------------
```

## src/main.cpp
```c
#include <zephyr.h>
#include <sys/byteorder.h>
#include <drivers/uart.h>
#include <soc.h>
#include <kernel.h>
#include <sys/printk.h>
#include <stddef.h>
#include <sys/util.h>
#include <errno.h>
#include <bluetooth/bluetooth.h>
#include <bluetooth/conn.h>
#include <bluetooth/gatt.h>
#include <bluetooth/gatt_dm.h>
#include <bluetooth/services/cts_client.h>
#include <bluetooth/uuid.h>
#include <bluetooth/scan.h>
#include <settings/settings.h>
#include <stdio.h>
#include <logging/log.h>
#include <logging/log_core.h>
#include <logging/log_ctrl.h>
#include <usb/usb_device.h>
#include "time.h"
#include <dk_buttons_and_leds.h>
#include <device.h>
#include <drivers/gpio.h>
#include <date_time.h>
#include <sys/timeutil.h>

// LOG CONFIG PARAMETERS
// ------------------------------------------------
#define LOG_MODULE_NAME ble_uart
LOG_MODULE_REGISTER(LOG_MODULE_NAME, LOG_LEVEL_DBG);
// ------------------------------------------------

// GLOBAL VARIABLES
// ------------------------------------------------
const struct device *uart;
// ------------------------------------------------


// IMPLEMENTED FUNCTIONS
// ------------------------------------------------
void print_filter_match(struct bt_scan_filter_match *filter_match);
void print_scan_info(const bt_addr_le_t *addr, int8_t rssi, uint8_t adv_type, struct net_buf_simple *buf, bool connectable);
static void scan_filter_match(struct bt_scan_device_info *device_info, struct bt_scan_filter_match *filter_match, bool connectable);
void scan_callback(const bt_addr_le_t *addr, int8_t rssi,uint8_t adv_type, struct net_buf_simple *buf);
static bool parse_frames(struct bt_data *data, void *user_data);
// ------------------------------------------------

//BLE CONFIG PARAMETERS
// ------------------------------------------------
#define DEVICE_NAME CONFIG_BT_DEVICE_NAME
#define DEVICE_NAME_LEN (sizeof(DEVICE_NAME) - 1)

//ESCANEO
//Se establece el callback que se ejecuta cuando un advertisement hace match con el filtro
char short_name[4] = {'I', 'T', 'S', '\0'};
BT_SCAN_CB_INIT(scan_cb, scan_filter_match, NULL, NULL, NULL);
// ------------------------------------------------



void main(void)
{
	int err;

	//inicialización del logger
	log_init();
	LOG_INF("Starting BLE-ITS (RX)\n\r");


	//Inicialización módulo UART: UART over USB
	uart = DEVICE_DT_GET_ONE(zephyr_cdc_acm_uart);
	if (!device_is_ready(uart)) {
		LOG_ERR("CDC ACM device not ready");
		while(1);
	}

	err = usb_enable(NULL);
	if (err != 0) {
		LOG_ERR("Failed to enable USB");
		while(1);
	}

	//Inicialización Bluetooth
	err = bt_enable(NULL); 
	if (err) {
		LOG_ERR("bt_enable: error %d\n", err);
		while(1);
	}

	LOG_INF("Bluetooth initialized");

	if (IS_ENABLED(CONFIG_SETTINGS)) {
		settings_load();
	}

	
	//Parámetros de escaneo
	struct bt_le_scan_param scan_param = { //Parametros de escaneo
		.type       = BT_LE_SCAN_TYPE_PASSIVE, //tipo de escaneo
		.options    = BT_LE_SCAN_OPT_FILTER_ACCEPT_LIST, //opciones escaneo
		.interval   = 0x0030, //intervalo de escaneo (48 * 0.625 ms) = 30 ms
		.window     = 0x0030, //ventana de escaneo (48 * 0.625 ms) = 30 ms
	};

	//Si el emisor como mucho va a a anunciar cada 30ms pongo como intervalo de escaneo 30ms
		struct bt_scan_init_param scan_init = {
		.scan_param = &scan_param,
		.connect_if_match = 0,
		.conn_param = NULL
	};


	LOG_INF("Inicio escaneo");
	bt_scan_init(&scan_init);
	bt_scan_cb_register(&scan_cb);

	//Se establece un filtro en base al SHORT NAME
	struct bt_scan_short_name bt_scan_sn;
	bt_scan_sn.name = short_name;
	bt_scan_sn.min_len = 4;

	LOG_INF("Name: %s, sizeof)%d", bt_scan_sn.name, sizeof(bt_scan_sn.name));

	err = bt_scan_filter_add(BT_SCAN_FILTER_TYPE_SHORT_NAME, &bt_scan_sn);
	if (err < 0) {
		LOG_ERR("Scanning filters cannot be set (err %d)", err);
		while(1);
	}

	err = bt_scan_filter_enable(BT_SCAN_SHORT_NAME_FILTER, false);
	if (err < 0) {
		LOG_ERR("Filters cannot be turned on (err %d)", err);
		while(1);
	}


	err = bt_le_scan_start(&scan_param, NULL);
	if(err < 0){
		LOG_ERR("Scanning failed to start (%d)", err);
	}

	LOG_INF("Scan module initialized");	
		

}


static void scan_filter_match(struct bt_scan_device_info *device_info,
			      struct bt_scan_filter_match *filter_match,
			      bool connectable)
{

	LOG_INF("----------------");
	LOG_INF("Filter matched");
	print_scan_info(device_info->recv_info->addr, device_info->recv_info->rssi, device_info->recv_info->adv_type, device_info->adv_data, connectable);
	print_filter_match(filter_match);
	LOG_INF("Advertising data");
	//envío a la pila la información de advertising
	uart_poll_out(uart, device_info->adv_data->len);
	for(int i = 0; i < device_info->adv_data->len; i++){
		uart_poll_out(uart, device_info->adv_data->data[i]);
	}
	
	bt_data_parse(device_info->adv_data, parse_frames, NULL);
	LOG_INF("----------------\n");
}

static bool parse_frames(struct bt_data *data, void *user_data){
	int err;

	switch(data->type){
		case BT_DATA_FLAGS:
			LOG_INF("	-> Flags: ");

			if((*(data->data) & BT_LE_AD_LIMITED) != 0){
				LOG_INF("		Limited Discoverable");
			}
			if((*(data->data) & BT_LE_AD_GENERAL) != 0){
				LOG_INF("		General Discoverable");
			}	

			if((*(data->data) & BT_LE_AD_NO_BREDR) != 0){
				LOG_INF("		BR/EDR not supported");
			}	

		break;

		case BT_DATA_MANUFACTURER_DATA:
			LOG_INF("	-> Manufacturer data (%d bytes)", data->data_len);
		break;

		case BT_DATA_NAME_SHORTENED:
			LOG_INF("	-> Shortened name");
		break;
	}

	return true;
}

void print_scan_info(const bt_addr_le_t *addr, int8_t rssi, uint8_t adv_type, struct net_buf_simple *buf, bool connectable){
	char print_addr[BT_ADDR_LE_STR_LEN];

	switch(addr->type){
		case BT_ADDR_LE_PUBLIC:
			LOG_INF("Address type:public");
		break;
		case BT_ADDR_LE_RANDOM:
			LOG_INF("Address type:random");
		break;
		case BT_ADDR_LE_PUBLIC_ID:
			LOG_INF("Address type:public_id");
		break;
		case BT_ADDR_LE_RANDOM_ID:
			LOG_INF("Address type:random_id");
		break;
		case BT_ADDR_LE_UNRESOLVED:
			LOG_INF("Address type:unresolved");
		break;
		case BT_ADDR_LE_ANONYMOUS:
			LOG_INF("Address type:anonymous");
		break;
	}

	bt_addr_le_to_str(addr, print_addr, sizeof(print_addr));

	LOG_INF("Address: %s",log_strdup(print_addr));

	LOG_INF("Connectable: %d", connectable);

	LOG_INF("RSSI: %d ",rssi);
	switch(adv_type){
		case BT_GAP_ADV_TYPE_ADV_IND:
			LOG_INF("Type: Scannable and connectable advertising");
		break;
		case BT_GAP_ADV_TYPE_ADV_DIRECT_IND :
			LOG_INF("Type: Directed connectable advertising");
		break;
		case BT_GAP_ADV_TYPE_ADV_SCAN_IND:
			LOG_INF("Type: Non-connectable and scannable advertising");
		break;
		case BT_GAP_ADV_TYPE_ADV_NONCONN_IND:
			LOG_INF("Type:Non-connectable and non-scannable advertising");
		break;
		case BT_GAP_ADV_TYPE_SCAN_RSP:
			LOG_INF("Type: Additional advertising data requested by an active scanner");
		break;
		case BT_GAP_ADV_TYPE_EXT_ADV:
			LOG_INF("Type: Extended advertising");
		break;
	}

	LOG_INF("The buffer can store: %d bytes", net_buf_simple_max_len(buf));
	LOG_INF("Advertising data length: %d", buf->len);
}

void print_filter_match(struct bt_scan_filter_match *filter_match){
	LOG_INF("Short Name filter matched: %s",filter_match->short_name.name);

	//Si el filtro está basado en UUID
	/*char uuid_str[37];
	memset(uuid_str, '\0', sizeof(uuid_str));
	for(int i=0; i<filter_match->uuid.len; i++){
			bt_uuid_to_str(filter_match->uuid.uuid[i], uuid_str, sizeof(uuid_str));		
			memset(uuid_str, '\0', sizeof(uuid_str));
	}*/
}
```
